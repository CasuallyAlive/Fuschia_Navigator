# file: rover.ioc
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Mcu.Family=STM32F0
Mcu.Name=STM32F072R(8-B)Tx
Mcu.Package=LQFP64
ProjectManager.HeapSize=0x200
ProjectManager.StackSize=0x400
ProjectManager.TargetToolchain=MDK-ARM V5.32
board=custom

// file: Core/Src/main.c
/* USER CODE BEGIN Header */
/**
  ******************************************************************************
  * @file           : main.c
  * @brief          : Main program body
  ******************************************************************************
  * @attention
  *
  * Copyright (c) 2023 STMicroelectronics.
  * All rights reserved.
  *
  * This software is licensed under terms that can be found in the LICENSE file
  * in the root directory of this software component.
  * If no LICENSE file comes with this software, it is provided AS-IS.
  *
  ******************************************************************************
  */
/* USER CODE END Header */
#include "main.h"

#define PI 4.0 * atan(1.0)
#define deg2rad(val) (val/180.0)*PI

#define DEG1 deg2rad(3*45.0)
#define DEG2 deg2rad(2*45.0)
#define DEG3 deg2rad(1*45.0)

/* USER CODE BEGIN PV */
volatile struct MotorStruct *motorL_e;
volatile struct MotorStruct *motorR_e;

volatile float sensID = 1.0, deg = 3*45, magn = 0.0;
const int IDLE_STATE = 0;
const int FOLLOW_WALL = 1;
const int GO_FORWARD = 2;
const int STOP = 4;

volatile int state = IDLE_STATE;

/* USER CODE END PV */

void SystemClock_Config(void);

/* USER CODE BEGIN 0 */

// Encoder interrupt to calculate motor speed, also manages PI controller
void TIM6_DAC_IRQHandler(void) {
	/* Calculate the motor speed in raw encoder counts
	 * Note the motor speed is signed! Motor can be run in reverse.
	 * Speed is measured by how far the counter moved from center point
	 */

	motorL_e->currentSpeed = ((TIM_TypeDef*) motorL_e->enc_tim)->CNT - 0x7FFF;
	((TIM_TypeDef*) motorL_e->enc_tim)->CNT = 0x7FFF;

	motorR_e->currentSpeed = ((TIM_TypeDef*) motorR_e->enc_tim)->CNT - 0x7FFF;
	((TIM_TypeDef*) motorR_e->enc_tim)->CNT = 0x7FFF;

	//motor_speed = (TIM3->CNT - 0x7FFF);
	//TIM3->CNT = 0x7FFF; // Reset back to center point

	// Call the PID update function
	if(state == GO_FORWARD){
		// output for MotorL
		struct MotorStruct motor1 = *motorL_e;
		int output1 = PID_Func(&motor1, motor1.target); // warning here because using motorL as val (which is fine)
		motorL_e->pid_params = motor1.pid_params;

		pwm_setDutyCycle(output1, motorL_e->pwm_tim);

		// output for MotorR
		struct MotorStruct motor2 = *motorR_e;
		int output2 = PID_Func(&motor2, motor2.target);
		motorR_e->pid_params = motor2.pid_params;

		pwm_setDutyCycle(output2, motorR_e->pwm_tim);
	}
	// Follow wall state PID update.
	else if(state == FOLLOW_WALL){

		int ref = ceil(magn*cos(deg));
		int output = PID_Func(NULL, ref); // careful Kd

		uint8_t ms1 = motorL_e->target, ms2 = motorR_e->target;
		// retrieve motor speed values (CLAMPED)
		calculateMotorSpeed(&ms1, &ms2, sensID, output);

		// Send pwm pulse to motorL
		pwm_setDutyCycle(ms1, motorL_e->pwm_tim);
		motorL_e->currentSpeed = ms1;

		// Send pwm pulse to motorR
		pwm_setDutyCycle(ms2, motorR_e->pwm_tim);
		motorL_e->currentSpeed = ms2;
	}
	TIM6->SR &= ~TIM_SR_UIF;        // Acknowledge the interrupt
}

void retrieveRefParams(float h1, float h2, float h3){
	// if wall detected on left and wall on left is the closest wall
	if(h1 < h2 && h1 < h3){
		sensID = 1.0;
		deg = DEG1;
		magn = h1; // get adjacent distance of rover to wall
	}
	//if wall directly in front of robot and side sensors less than h2
	else if(h2 < h1 && h2 < h3){
		float m, deg_m;
		//if next closest point is h1
		if(h1 < h3){
			sensID = 1.5; // 2.0 - 0.5
			m = h2;
			deg_m = DEG1;
		}
		else{
			sensID = 2.5; // 2.0 + 0.5
			m = h3;
			deg_m = DEG3;
		}
		deg = deg_m - deg2rad(45.0/2.0);
		magn = ((h2+m)/2);
	}
	//if wall detected on right and wall on right is the closest wall
	else if(h3 < h1 && h3 < h2){
		sensID = 3.0;
		deg = DEG3;
		magn = h3;
	}
	// enter here if general assumption is that sensors have the same relative distance from all walls, go straight!
	else{
		sensID = 1.0;
		deg = DEG1;
		magn = target_wall_follow;
	}
}

void calculateMotorSpeed(uint8_t *motorSpeed1, uint8_t *motorSpeed2, float sensID, int output){
	// Point between h1 and h2 or at h1
	if(sensID >= 1.0 || sensID <= 1.5){
		// set speed for motorL_e
		*motorSpeed1 -= output;
		// set speed for motorR_e
		*motorSpeed2 += output;
	}
	// Point between h2 and h3 or at h3
	else if(sensID >= 2.0 || sensID <= 2.5){
		// set speed for motorL_e
		*motorSpeed1 += output;
		// set speed for motorR_e
		*motorSpeed2 -= output;
	}
	*motorSpeed1 = getAdjustedSpeed(*motorSpeed1);
	*motorSpeed2 = getAdjustedSpeed(*motorSpeed1);
}

GPIO_TypeDef* getGPIOStructM(char port){
	if(port == 'a' || port == 'A'){
		return GPIOA;
	}
	else if(port == 'b' || port == 'B'){
		return GPIOB;
	}
	else if(port == 'c' || port == 'C'){
		return GPIOC;
	}
	else if(port == 'd' || port == 'D'){
		return GPIOD;
	}
	else if(port == 'e' || port == 'E'){
		return GPIOE;
	}
	else if(port == 'f' || port == 'F'){
		return GPIOF;
	}
	else{
		return GPIOA;
	}
}
/* USER CODE END 0 */
int min(int v1, int v2){
	if(v1 < v2)
		return v1;
	return v2;
}
int main(void)
{

  HAL_Init();

  /* Configure the system clock */
  SystemClock_Config();

  /* Initialize all configured peripherals */
  /* USER CODE BEGIN 2 */

	// struct for the right motor
	struct MotorStruct motorL = {
	.dir = 1,
	.pwm_port = 'A', .in1_port = 'A', .in2_port = 'A', .encA_port = 'B', .encB_port = 'B',
	.pwm_pin = 4, .in1_pin = 5, .in2_pin = 6, .encA_pin = 4, .encB_pin = 5,
	.in1 = 1, .in2 = 0,
	.alt_func = 0x4,
	.pwm_tim = TIM14, .enc_tim = TIM3, .pwm_gpio = GPIOA, .enc_gpio = GPIOB, // Assume {}_tim vars are TIM_Typedef pointers
	.currentSpeed = 0,
	.target = 100,
	};
	motorL_e = &motorL;

	// struct for the right motor
	struct MotorStruct motorR = {
	.dir = 1,
	.pwm_port = 'A', .in1_port = 'A', .in2_port = 'A', .encA_port = 'B', .encB_port = 'B',
	.pwm_pin = 2, .in1_pin = 8, .in2_pin = 9, .encA_pin = 10, .encB_pin = 11,
	.in1 = 1, .in2 = 0,
	.alt_func = 0,
	.pwm_tim = TIM15, .enc_tim = TIM2, .pwm_gpio = GPIOA, .enc_gpio = GPIOB, // Assume {}_tim vars are TIM_Typedef pointers
	.currentSpeed = 0,
	.target = 100,
	};
	motorR_e = &motorR;

	// Produces an interrupt period of 0.056s or 18Hz
	uint32_t psc = 15;
	uint32_t arr = 27778;

	// Setup GPIO stuff

  RCC->AHBENR |= RCC_AHBENR_GPIOAEN | RCC_AHBENR_GPIOBEN | RCC_AHBENR_GPIOCEN;
	pwm_init(&motorL, &motorR, RCC_APB1ENR_TIM14EN, RCC_APB2ENR_TIM15EN, 1, 0); // TIM14 on APB1, and TIM15 on APB2
	encoder_init(&motorL, &motorR, psc, arr, RCC_APB1ENR_TIM3EN, RCC_APB1ENR_TIM2EN, 1, 0); // Setup ch1,2 on TIM3 and setup ch3,4 on TIM2

	setPIDFunc(0); // Set PID to "straight"
	uint8_t nextState = state;

	// init IR
	initLEDS();
	initIRSensors();

	ADCInitSingleConversion();

	// End Moder Setup
	float h1, h2, h3;
  /* USER CODE END 2 */

  /* Infinite loop */
  /* USER CODE BEGIN WHILE */
  while (1)
  {
		h1 = getSensorData(1);
		h2 = getSensorData(3);
		h3 = getSensorData(2);

		retrieveRefParams(h1,h2,h3);

		if(state == IDLE_STATE){
			nextState = GO_FORWARD;
		}
		else if(state == GO_FORWARD){
			if(min(min(h1,h2), h3) <= 5){
				nextState = STOP; // fail or finished
			}
			else if(min(min(h1,h2), h3) <= 25){
				nextState = FOLLOW_WALL;
				resetPID(&motorL,&motorR);
			}
		}
		else if(state == FOLLOW_WALL){
			if(min(min(h1,h2), h3) <= 5){
				nextState = STOP; // fail or finished
			}
			else if(h1 >= 30 && h3 >= 30 && h2 >= 30){
				nextState = GO_FORWARD;
				resetPID(&motorL,&motorR);
			}
		}
		else if(state == STOP){
			resetPID(&motorL,&motorR);
		}
		if(state != nextState)
			state = nextState;
  }
  /* USER CODE END 3 */
}

void SystemClock_Config(void)
{
  RCC_OscInitTypeDef RCC_OscInitStruct = {0};
  RCC_ClkInitTypeDef RCC_ClkInitStruct = {0};

  /** Initializes the RCC Oscillators according to the specified parameters
  * in the RCC_OscInitTypeDef structure.
  */
  RCC_OscInitStruct.OscillatorType = RCC_OSCILLATORTYPE_HSI;
  RCC_OscInitStruct.HSIState = RCC_HSI_ON;
  RCC_OscInitStruct.HSICalibrationValue = RCC_HSICALIBRATION_DEFAULT;
  RCC_OscInitStruct.PLL.PLLState = RCC_PLL_NONE;
  if (HAL_RCC_OscConfig(&RCC_OscInitStruct) != HAL_OK)
  {
    Error_Handler();
  }

  /** Initializes the CPU, AHB and APB buses clocks
  */
  RCC_ClkInitStruct.ClockType = RCC_CLOCKTYPE_HCLK|RCC_CLOCKTYPE_SYSCLK
                              |RCC_CLOCKTYPE_PCLK1;
  RCC_ClkInitStruct.SYSCLKSource = RCC_SYSCLKSOURCE_HSI;
  RCC_ClkInitStruct.AHBCLKDivider = RCC_SYSCLK_DIV1;
  RCC_ClkInitStruct.APB1CLKDivider = RCC_HCLK_DIV1;

  if (HAL_RCC_ClockConfig(&RCC_ClkInitStruct, FLASH_LATENCY_0) != HAL_OK)
  {
    Error_Handler();
  }
}

void Error_Handler(void)
{
  __disable_irq();
  while (1)
  {
  }
}
